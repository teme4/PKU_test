/******************************************************************************/
/*     	 Name:         spi_soft_my.c                                          */
/*       Author:       Vladimir Pecherskih                                    */
/*       Date:         07.09.2020                                             */
/******************************************************************************/
#include "main.h"
#include "spi_soft_my.h"

/******************************************************************************/
/*              Constant declarations :                                       */
/******************************************************************************/

/******************************************************************************/
/*              Variable declarations :                                       */
/******************************************************************************/
uint8_t	    spi_rx[SPI_RX_LEN];

/******************************************************************************/
/*      	    Functions declarations :                                      */
/******************************************************************************/
void      SPI_Delay(uint16_t cnt);
void      SPI_Select(void);
void      SPI_Unselect(void);

void      SPI_SoftInit(void);
uint8_t   SPI_TxRxByte(uint8_t tx_rx_byte);
uint8_t   SPI_ReadStatus(void);
uint8_t   SPI_ReadByte(uint8_t reg);
uint8_t   SPI_ReadBuffer(uint8_t reg, uint8_t len);
uint8_t   SPI_WriteCommand(uint8_t reg);
uint8_t   SPI_WriteByte(uint8_t reg, uint8_t value);
uint8_t   SPI_WriteBuffer(uint8_t reg, const uint8_t* buf, uint8_t len);

uint8_t   SPI_WriteCommand(uint8_t reg);

/******************************************************************************/
/******************************************************************************/





/******************************************************************************/
/******************************************************************************/
/*                                                                            */
/*  				        S P I                                             */
/*                                                                            */
/******************************************************************************/
/******************************************************************************/
void  SPI_SoftInit(void)
{
  //GPIO_Init(SPI_MISO_PORT, SPI_MISO_PIN, GPIO_Mode_In_PU_No_IT);	    // Input pull-up, no external interrupt
  //GPIO_Init(SPI_MOSI_PORT, SPI_MOSI_PIN, GPIO_Mode_Out_PP_Low_Fast);	// Output push-pull, low level, 10MHz	
  //GPIO_Init(SPI_CLK_PORT,  SPI_CLK_PIN,  GPIO_Mode_Out_PP_Low_Fast);	// Output push-pull, low level, 10MHz	
  //GPIO_Init(SPI_CSN_PORT,  SPI_CSN_PIN,  GPIO_Mode_Out_PP_High_Fast);	// Output push-pull, high level, 10MHz	
} 
/******************************************************************************/
/******************************************************************************/
uint8_t  SPI_TxRxByte(uint8_t tx_rx_byte)		// время передачи байта ????????
{
  uint8_t i;
  
  //-----------------------------------	
  for (i = 0; i < 8; i++)
  {
    SPI_CLK_LOW;
    SPI_Delay(1);
    
    if(tx_rx_byte & 0x80) SPI_MOSI_HIGH;
    else                  SPI_MOSI_LOW;
    SPI_Delay(1);
    
    SPI_CLK_HIGH;	
    SPI_Delay(1); 
      
    tx_rx_byte <<= 1; 				        // сдвигаем байт приема/передачи
    
    if((SPI_MISO_PORT->IDR & (uint8_t)SPI_MISO_PIN))	tx_rx_byte |=  0x01;
    else						tx_rx_byte &= ~0x01;
  }
  //------------------------------------
  SPI_CLK_LOW;
  SPI_Delay(1); 
  SPI_MOSI_LOW;
  SPI_Delay(1); 

  return tx_rx_byte;
}
/******************************************************************************/
/******************************************************************************/
uint8_t   SPI_ReadByte(uint8_t reg)
{
  uint8_t result;
  
  SPI_CSN_LOW;
  SPI_Delay(1); 
  //-----------------------------------
  SPI_TxRxByte(reg);
  result = SPI_TxRxByte(0xFF);
  //-----------------------------------
   SPI_CSN_HIGH;
  SPI_Delay(1); 
   
   return result;
}
/******************************************************************************/
/******************************************************************************/
uint8_t   SPI_ReadBuffer(uint8_t reg, uint8_t len)
{
  uint8_t i;  
  uint8_t status;
  
  SPI_CSN_LOW;
  SPI_Delay(1); 
  //-----------------------------------
  status = SPI_TxRxByte(reg);

  for(i=0; i<len; i++)
  {
     spi_rx[i] = SPI_TxRxByte(0xFF);
  }
  //-----------------------------------
   SPI_CSN_HIGH; 
   SPI_Delay(1); 
   
   return status;
}
/******************************************************************************/
/******************************************************************************/
uint8_t   SPI_WriteByte(uint8_t reg, uint8_t value)
{
  uint8_t status;

  SPI_CSN_LOW;
  SPI_Delay(1); 
  //-----------------------------------
  status = SPI_TxRxByte(reg  | 0x20);
  SPI_TxRxByte(value);
  //-----------------------------------
   SPI_CSN_HIGH;
   SPI_Delay(1); 
   
   return status;
}
/******************************************************************************/
/******************************************************************************/
uint8_t   SPI_WriteBuffer(uint8_t reg, const uint8_t* buf, uint8_t len)
{
  uint8_t i;
  uint8_t status;

  SPI_CSN_LOW;
  SPI_Delay(1); 
  //-----------------------------------
  status = SPI_TxRxByte(reg | 0x20);
  
  for(i=0; i<len; i++)
      SPI_TxRxByte(buf[i]);
  //-----------------------------------
  SPI_CSN_HIGH; 
  SPI_Delay(1); 
     
  return status; 
}
/******************************************************************************/
/******************************************************************************/





/******************************************************************************/
/******************************************************************************/
/*                                                                            */
/*                        	A D D                                             */
/*                                                                            */
/******************************************************************************/
/******************************************************************************/
void SPI_Delay(uint16_t cnt)
{
    int i;
    for (i=0;i<cnt;i++) __NOP();
}
/******************************************************************************/
/******************************************************************************/
void SPI_Select(void)
{
    SPI_CSN_LOW;
}
/******************************************************************************/
/******************************************************************************/
void SPI_Unselect(void)
{
    SPI_CSN_HIGH;
}
/******************************************************************************/
/******************************************************************************/
uint8_t   SPI_ReadStatus(void)
{
  uint8_t status;
  
  SPI_CSN_LOW;
  __NOP(); __NOP(); __NOP();
  //-----------------------------------
  status = SPI_TxRxByte(0xFF);
  //-----------------------------------
  SPI_CSN_HIGH;  
  return status; 
}
/******************************************************************************/
/******************************************************************************/
uint8_t   SPI_WriteCommand(uint8_t reg)
{
  uint8_t status;
    
  SPI_CSN_LOW;
  __NOP(); __NOP(); __NOP();
  //-----------------------------------
  status = SPI_TxRxByte(reg);
  //-----------------------------------
  SPI_CSN_HIGH;
  return status; 
}   
/******************************************************************************/
/******************************************************************************/